## prj.conf
```kconfig
# General
CONFIG_GPIO=y
CONFIG_LOG=y
CONFIG_REBOOT=y

# Heap and stacks
CONFIG_HEAP_MEM_POOL_SIZE=32768
CONFIG_MAIN_STACK_SIZE=8192
CONFIG_SYSTEM_WORKQUEUE_STACK_SIZE=4096

# Nrf modem
CONFIG_NRF_MODEM_LIB=y
CONFIG_MODEM_INFO=y
CONFIG_LTE_LINK_CONTROL=y
CONFIG_MODEM_KEY_MGMT=y # Needed by lwm2m_client_utils

# Networking
CONFIG_NETWORKING=y
CONFIG_NET_SOCKETS=y
CONFIG_NET_SOCKETS_OFFLOAD=y
CONFIG_DNS_RESOLVER=y

# LwM2M
CONFIG_LWM2M=y
CONFIG_LWM2M_COAP_BLOCK_SIZE=512
CONFIG_LWM2M_ENGINE_MAX_MESSAGES=10
CONFIG_LWM2M_ENGINE_MAX_OBSERVER=5
CONFIG_LWM2M_FIRMWARE_UPDATE_OBJ_SUPPORT=n
CONFIG_LWM2M_FIRMWARE_UPDATE_PULL_SUPPORT=y
CONFIG_LWM2M_RW_OMA_TLV_SUPPORT=y
CONFIG_LWM2M_CLIENT_UTILS=y
CONFIG_LWM2M_CLIENT_UTILS_ADV_FIRMWARE_UPDATE_OBJ_SUPPORT=y
CONFIG_LWM2M_CLIENT_UTILS_ADV_FOTA_INSTANCE_COUNT=3
CONFIG_FOTA_CLIENT_AUTOSCHEDULE_UPDATE=n
CONFIG_LWM2M_LOG_LEVEL_DBG=y
CONFIG_DOWNLOADER_LOG_LEVEL_DBG=y
CONFIG_FOTA_DOWNLOAD_LOG_LEVEL_DBG=y
CONFIG_DFU_TARGET_LOG_LEVEL_DBG=y
CONFIG_LWM2M_CLIENT_UTILS_SERVER="coap://<server>:5683"

# FOTA download
CONFIG_FOTA_DOWNLOAD=y
CONFIG_DOWNLOADER=y
CONFIG_DOWNLOADER_STACK_SIZE=4096

# External flash (secondary slot)
CONFIG_GPIO=y
CONFIG_SPI=y
CONFIG_SPI_NOR=y
CONFIG_SPI_NOR_SFDP_DEVICETREE=y
CONFIG_SPI_NOR_FLASH_LAYOUT_PAGE_SIZE=4096
# QSPI drivers are enabled by defualt for some chips.
# Disable it explicitly to be sure QSPI is disabled.
CONFIG_NORDIC_QSPI_NOR=n

# DFU target
CONFIG_DFU_TARGET=y
CONFIG_DFU_TARGET_MCUBOOT=y
# 3 = bank1(img0) + bank0(img1) + mcuboot-s0/s1(img2), matches MCUboot's slot table.
# APP_SYNC disabled in sysbuild.conf so sysbuild doesn't override this with 2.
CONFIG_UPDATEABLE_IMAGE_NUMBER=3
CONFIG_IMG_MANAGER=y
CONFIG_FLASH=y
CONFIG_FLASH_MAP=y
CONFIG_STREAM_FLASH=y
CONFIG_IMG_ERASE_PROGRESSIVELY=y

# Settings (required for FOTA state persistence)
CONFIG_SETTINGS_NVS=y
CONFIG_SETTINGS=y
```

## src/firmware_update.c
```c
#include <zephyr/kernel.h>
#include <zephyr/logging/log.h>
#include <zephyr/net/lwm2m.h>
#include <zephyr/sys/reboot.h>

#include <net/lwm2m_client_utils.h>

LOG_MODULE_REGISTER(firmware_update);

static int fota_event_cb(struct lwm2m_fota_event *event)
{
  switch (event->id) {
  case LWM2M_FOTA_DOWNLOAD_START:
    LOG_INF("Download started, instance %d", event->download_start.obj_inst_id);
    break;
  case LWM2M_FOTA_DOWNLOAD_FINISHED:
    LOG_INF("Download done, DFU type: %d", event->download_ready.dfu_type);
    break;
  case LWM2M_FOTA_UPDATE_IMAGE_REQ:
    /* Return 0 to accept, negative to defer */
    LOG_INF("Update requested, instance %d", event->update_req.obj_inst_id);
    return 0;
  case LWM2M_FOTA_UPDATE_MODEM_RECONNECT_REQ:
    /* TODO: Modem update requires LTE reconnection
     * handle it here
     */
    break;
  case LWM2M_FOTA_UPDATE_ERROR:
    LOG_ERR("Update failed on instance %d, code %d", event->failure.obj_inst_id,
            event->failure.update_failure);
    break;
  }
  return 0;
}

int setup_firmware_object(void)
{
  int ret;

  lwm2m_init_firmware_cb(fota_event_cb);

  /* Confirm MCUboot image pair 1 (bank0) and sync result to server */
  ret = lwm2m_init_image_multi(1);
  if (ret < 0) {
    LOG_ERR("Failed to setup image properties: %d", ret);
    return ret;
  }

  return 0;
}
```
