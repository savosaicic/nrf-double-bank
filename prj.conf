## CMakeLists.txt
```
cmake_minimum_required(VERSION 3.20.0)

set(DTC_OVERLAY_FILE ${CMAKE_CURRENT_SOURCE_DIR}/bank1/boards/nrf9151dk_nrf9151_ns.overlay)

find_package(Zephyr REQUIRED HINTS $ENV{ZEPHYR_BASE})
project(bank1)

target_include_directories(app PRIVATE bank1/include)
target_sources(app PRIVATE
  bank1/src/main.c
  bank1/src/gnss.c
  bank1/src/temperature.c
  bank1/src/ecompass.c
  bank1/src/firmware_update.c
)
```

## sysbuild.conf
```
# Enable NSIB (b0) as the first-stage immutable bootloader
SB_CONFIG_SECURE_BOOT_APPCORE=y

# Enable MCUboot as the second-stage upgradable bootloader
SB_CONFIG_BOOTLOADER_MCUBOOT=y

# image0 = bank1, image1 = bank0, image2 = mcuboot s0/s1
SB_CONFIG_MCUBOOT_UPDATEABLE_IMAGES=2

# Disable sysbuild forcing UPDATEABLE_IMAGE_NUMBER=2 onto app images.
# With two-stage bootloader (b0+mcuboot) and two app images (bank0/bank1),
# apps need UPDATEABLE_IMAGE_NUMBER=3 so FLASH_AREA_IMAGE_SECONDARY(1)
# resolves to mcuboot_secondary_1 (bank0 slot) not mcuboot_secondary (bank1 slot).
# MCUboot already gets 3 (2 + 1 additional for s0/s1); apps must match.
SB_CONFIG_MCUBOOT_APP_SYNC_UPDATEABLE_IMAGES=n

# Use partition manager with the static YAML in the project root
SB_CONFIG_PARTITION_MANAGER=y

# Operational mode: swap (default)
SB_CONFIG_MCUBOOT_MODE_SWAP_USING_MOVE=y
#SB_CONFIG_MCUBOOT_MODE_OVERWRITE_ONLY=n

# Use external flash
SB_CONFIG_PM_EXTERNAL_FLASH_MCUBOOT_SECONDARY=y
SB_CONFIG_PM_OVERRIDE_EXTERNAL_DRIVER_CHECK=y
```

## prj.conf
```kconfig
# General
CONFIG_REBOOT=y
CONFIG_LOG=y
CONFIG_NEWLIB_LIBC=y
CONFIG_NEWLIB_LIBC_FLOAT_PRINTF=y
CONFIG_FPU=y

# Heap and stacks
CONFIG_HEAP_MEM_POOL_SIZE=32768
CONFIG_MAIN_STACK_SIZE=8192
CONFIG_SYSTEM_WORKQUEUE_STACK_SIZE=4096

# Nrf modem
CONFIG_NRF_MODEM_LIB=y
CONFIG_MODEM_INFO=y
CONFIG_LTE_LINK_CONTROL=y
CONFIG_MODEM_KEY_MGMT=y # Needed by lwm2m_client_utils
CONFIG_LTE_NETWORK_MODE_LTE_M_NBIOT_GPS=y
CONFIG_LTE_LC_EDRX_MODULE=y
CONFIG_LTE_LC_PSM_MODULE=y

# PSM periodic TAU and active time
# encoded as (timer unit * multiplier) in binary
# per 3GPP TS 24.008
CONFIG_LTE_PSM_REQ_RPTAU="00101000" # 8 Hours
CONFIG_LTE_PSM_REQ_RAT="00001000"   # 16 secs

# Networking
CONFIG_NETWORKING=y
CONFIG_NET_SOCKETS=y
CONFIG_NET_SOCKETS_OFFLOAD=y
CONFIG_DNS_RESOLVER=y

# LwM2M
CONFIG_LWM2M=y
CONFIG_LWM2M_COAP_BLOCK_SIZE=512
CONFIG_LWM2M_ENGINE_MAX_MESSAGES=10
CONFIG_LWM2M_ENGINE_MAX_OBSERVER=5
CONFIG_LWM2M_IPSO_SUPPORT=y
CONFIG_LWM2M_IPSO_TEMP_SENSOR=y
CONFIG_LWM2M_IPSO_ACCELEROMETER=y
CONFIG_LWM2M_FIRMWARE_UPDATE_OBJ_SUPPORT=n
CONFIG_LWM2M_FIRMWARE_UPDATE_PULL_SUPPORT=y
CONFIG_LWM2M_RW_OMA_TLV_SUPPORT=y
CONFIG_LWM2M_CLIENT_UTILS=y
CONFIG_LWM2M_CLIENT_UTILS_SERVER="coap://<server>:5683"
CONFIG_LWM2M_CLIENT_UTILS_ADV_FIRMWARE_UPDATE_OBJ_SUPPORT=y
CONFIG_LWM2M_CLIENT_UTILS_ADV_FOTA_INSTANCE_COUNT=3
CONFIG_FOTA_CLIENT_AUTOSCHEDULE_UPDATE=n
CONFIG_LWM2M_CLIENT_UTILS_LOG_LEVEL_DBG=y

# Sensors
CONFIG_I2C=y
CONFIG_SENSOR=y
CONFIG_LIS2DH=y
CONFIG_LIS2MDL=y
CONFIG_STTS22H=y

# FOTA download
CONFIG_FOTA_DOWNLOAD=y
CONFIG_DOWNLOADER=y
CONFIG_DOWNLOADER_STACK_SIZE=4096

# External flash (secondary slot)
CONFIG_GPIO=y
CONFIG_SPI=y
CONFIG_SPI_NOR=y
CONFIG_SPI_NOR_SFDP_DEVICETREE=y
CONFIG_SPI_NOR_FLASH_LAYOUT_PAGE_SIZE=4096
# QSPI drivers are enabled by defualt for some chips.
# Disable it explicitly to be sure QSPI is disabled.
CONFIG_NORDIC_QSPI_NOR=n

# DFU target
CONFIG_DFU_TARGET=y
CONFIG_DFU_TARGET_MCUBOOT=y
# 3 = bank1(img0) + bank0(img1) + mcuboot-s0/s1(img2), matches MCUboot's slot table.
# APP_SYNC disabled in sysbuild.conf so sysbuild doesn't override this with 2.
CONFIG_UPDATEABLE_IMAGE_NUMBER=3
CONFIG_IMG_MANAGER=y
CONFIG_FLASH=y
CONFIG_FLASH_MAP=y
CONFIG_STREAM_FLASH=y
CONFIG_IMG_ERASE_PROGRESSIVELY=y

# Settings (required for FOTA state persistence)
CONFIG_NVS=y
CONFIG_FLASH_MAP=y
CONFIG_SETTINGS=y
CONFIG_SETTINGS_NVS=y
```

## src/main.c
```c
#include <modem/lte_lc.h>
#include <zephyr/kernel.h>
#include <zephyr/logging/log.h>
#include <zephyr/net/lwm2m.h>
#include <zephyr/sys/reboot.h>
#include <modem/nrf_modem_lib.h>
#include <net/lwm2m_client_utils.h>

#include "gnss.h"
#include "temperature.h"
#include "ecompass.h"
#include "firmware_update.h"

LOG_MODULE_REGISTER(nrf91_lwm2m_client);

#define ENDPOINT_NAME "your-endpoint-name"
#define SERVER_ID     1
#define LIFETIME_S    60

static K_SEM_DEFINE(lte_connected, 0, 1);

static const char manufacturer[] = "Nordic Semiconductor";
static const char model[]        = "nRF9151-DK";
static const char serial[]       = "SN-001";
static const char fw_ver[]       = "1.0.0";

static struct lwm2m_ctx client_ctx;

static void lte_handler(const struct lte_lc_evt *const evt)
{
  switch (evt->type) {
  case LTE_LC_EVT_NW_REG_STATUS:
    if (evt->nw_reg_status != LTE_LC_NW_REG_REGISTERED_HOME &&
        evt->nw_reg_status != LTE_LC_NW_REG_REGISTERED_ROAMING) {
      break;
    }
    LOG_INF("LTE registered: %s",
            evt->nw_reg_status == LTE_LC_NW_REG_REGISTERED_HOME ? "home network"
                                                                : "roaming");
    k_sem_give(&lte_connected);
    break;

  case LTE_LC_EVT_RRC_UPDATE:
    LOG_INF("RRC mode: %s",
            evt->rrc_mode == LTE_LC_RRC_MODE_CONNECTED ? "connected" : "idle");
    break;

  case LTE_LC_EVT_PSM_UPDATE:
    LOG_INF("PSM parameter update: TAU: %d s, Active time: %d s",
            evt->psm_cfg.tau, evt->psm_cfg.active_time);
    if (evt->psm_cfg.active_time == -1) {
      LOG_ERR("Network rejected PSM parameters. Failed to enable PSM");
    }
    break;

  case LTE_LC_EVT_EDRX_UPDATE:
    LOG_INF("eDRX parameter update: eDRX: %.2f s, PTW: %.2f s",
            (double)evt->edrx_cfg.edrx, (double)evt->edrx_cfg.ptw);
    break;

  default:
    break;
  }
}

static int modem_configure(void)
{
  int err;

  LOG_INF("Initializing modem library");
  err = nrf_modem_lib_init();
  if (err) {
    LOG_ERR("Failed to initialize the modem library, error: %d", err);
    return err;
  }

  LOG_INF("Connecting to LTE network");
  err = lte_lc_connect_async(lte_handler);
  if (err) {
    LOG_ERR("lte_lc_connect_async failed: %d", err);
    return err;
  }

  k_sem_take(&lte_connected, K_FOREVER);
  LOG_INF("Connected to LTE network");

  return 0;
}

static void observe_cb(enum lwm2m_observe_event event,
                       struct lwm2m_obj_path *path, void *user_data)
{
  char buf[LWM2M_MAX_PATH_STR_SIZE];

  switch (event) {
  case LWM2M_OBSERVE_EVENT_OBSERVER_ADDED:
    LOG_INF("Observer added for %s", lwm2m_path_log_buf(buf, path));
    break;
  case LWM2M_OBSERVE_EVENT_OBSERVER_REMOVED:
    LOG_INF("Observer removed for %s", lwm2m_path_log_buf(buf, path));
    break;
  case LWM2M_OBSERVE_EVENT_NOTIFY_ACK:
    LOG_INF("Notify ACK for %s", lwm2m_path_log_buf(buf, path));
    break;
  case LWM2M_OBSERVE_EVENT_NOTIFY_TIMEOUT:
    LOG_WRN("Notify timeout for %s — triggering reg update",
            lwm2m_path_log_buf(buf, path));
    lwm2m_rd_client_update();
    break;
  }
}

static void rd_client_event(struct lwm2m_ctx *client,
                            enum lwm2m_rd_client_event event)
{
  switch (event) {
  case LWM2M_RD_CLIENT_EVENT_NONE:
    break;
  case LWM2M_RD_CLIENT_EVENT_BOOTSTRAP_REG_FAILURE:
    LOG_ERR("Bootstrap registration failure");
    break;
  case LWM2M_RD_CLIENT_EVENT_BOOTSTRAP_REG_COMPLETE:
    LOG_INF("Bootstrap registration complete");
    break;
  case LWM2M_RD_CLIENT_EVENT_BOOTSTRAP_TRANSFER_COMPLETE:
    LOG_INF("Bootstrap transfer complete");
    break;
  case LWM2M_RD_CLIENT_EVENT_REGISTRATION_FAILURE:
    LOG_ERR("Registration failure");
    break;
  case LWM2M_RD_CLIENT_EVENT_REGISTRATION_COMPLETE:
    LOG_INF("Registration complete");
    break;
  case LWM2M_RD_CLIENT_EVENT_REG_TIMEOUT:
    LOG_WRN("Registration timeout");
    break;
  case LWM2M_RD_CLIENT_EVENT_REG_UPDATE_COMPLETE:
    LOG_INF("Registration update complete");
    break;
  case LWM2M_RD_CLIENT_EVENT_DEREGISTER_FAILURE:
    LOG_ERR("Deregister failure");
    break;
  case LWM2M_RD_CLIENT_EVENT_DISCONNECT:
    LOG_WRN("Disconnected");
    break;
  case LWM2M_RD_CLIENT_EVENT_QUEUE_MODE_RX_OFF:
    LOG_DBG("Queue mode RX window closed");
    break;
  case LWM2M_RD_CLIENT_EVENT_ENGINE_SUSPENDED:
    LOG_DBG("Engine suspended");
    break;
  case LWM2M_RD_CLIENT_EVENT_SERVER_DISABLED:
    LOG_DBG("Server disabled");
    break;
  case LWM2M_RD_CLIENT_EVENT_REG_UPDATE:
    LOG_DBG("Registration update sent");
    break;
  case LWM2M_RD_CLIENT_EVENT_DEREGISTER:
    LOG_DBG("Deregister sent");
    break;

  /*
   * NETWORK_ERROR must call lwm2m_rd_client_stop()
   * Failing to do so leaves the engine in a broken state
   */
  case LWM2M_RD_CLIENT_EVENT_NETWORK_ERROR:
    LOG_ERR("Network error, stopping client");
    lwm2m_rd_client_stop(client, rd_client_event, true);
    break;
  }
}

static int device_reboot_cb(uint16_t obj_inst_id, uint8_t *args,
                            uint16_t args_len)
{
  LOG_INF("Reboot requested by server");
  sys_reboot(SYS_REBOOT_COLD);
  return 0;
}

/*
 * Server Object (ID 1)
 * Short Server ID is set by lwm2m_client_utils; we only override the rest.
 */
static void setup_server_object(void)
{
  /* Resource 1: Lifetime */
  lwm2m_set_u32(&LWM2M_OBJ(1, 0, 1), LIFETIME_S);

  /* Resource 6: Notification storing while disabled/offline */
  lwm2m_set_bool(&LWM2M_OBJ(1, 0, 6), false);

  /* Resource 7: Binding: "U" = UDP */
  lwm2m_set_string(&LWM2M_OBJ(1, 0, 7), "U");
}

/* Called by lwm2m_client_utils to acknowledge a pending CoAP request */
void client_acknowledge(void)
{
  lwm2m_acknowledge(&client_ctx);
}

/*
 * Device Object (ID 3)
 * Object describing the device itself
 */
static void setup_device_object(void)
{
  lwm2m_set_res_buf(&LWM2M_OBJ(3, 0, 0), (void *)manufacturer,
                    sizeof(manufacturer), sizeof(manufacturer),
                    LWM2M_RES_DATA_FLAG_RO);
  lwm2m_set_res_buf(&LWM2M_OBJ(3, 0, 1), (void *)model, sizeof(model),
                    sizeof(model), LWM2M_RES_DATA_FLAG_RO);
  lwm2m_set_res_buf(&LWM2M_OBJ(3, 0, 2), (void *)serial, sizeof(serial),
                    sizeof(serial), LWM2M_RES_DATA_FLAG_RO);
  lwm2m_set_res_buf(&LWM2M_OBJ(3, 0, 3), (void *)fw_ver, sizeof(fw_ver),
                    sizeof(fw_ver), LWM2M_RES_DATA_FLAG_RO);

  /* Register reboot cb */
  lwm2m_register_exec_callback(&LWM2M_OBJ(3, 0, 4), device_reboot_cb);
}

static int lwm2m_setup(void)
{
  int ret;

  /* Writes server URL from CONFIG_LWM2M_CLIENT_UTILS_SERVER and sets NoSec */
  ret = lwm2m_init_security(&client_ctx, ENDPOINT_NAME, NULL);
  if (ret < 0) {
    LOG_ERR("Failed to init security object: %d", ret);
    return ret;
  }

  setup_server_object();
  setup_device_object();

  ret = setup_firmware_object();
  if (ret < 0) {
    LOG_ERR("Firmware object setup failed: %d", ret);
    return ret;
  }

  ret = setup_temperature_sensor();
  if (ret < 0) {
    LOG_ERR("Temperature object setup failed: %d", ret);
    return ret;
  }

  ret = setup_ecompass();
  if (ret < 0) {
    LOG_ERR("eCompass object setup failed: %d", ret);
    return ret;
  }

  return 0;
}

int main(void)
{
  int ret;

  LOG_INF("*** BANK1 ***");

  ret = modem_configure();
  if (ret) {
    LOG_ERR("modem_configure failed: %d", ret);
    return ret;
  }

  ret = gnss_init_and_start();
  if (ret) {
		LOG_ERR("Failed to initialize and start GNSS");
    return ret;
  }

  LOG_INF("Starting LwM2M client");
  memset(&client_ctx, 0, sizeof(client_ctx));
  ret = lwm2m_setup();
  if (ret < 0) {
    LOG_ERR("LwM2M setup failed: %d", ret);
    return ret;
  }

  lwm2m_rd_client_start(&client_ctx, ENDPOINT_NAME, 0, rd_client_event,
                        observe_cb);

  while (1) {
    k_sleep(K_FOREVER);
  }

  return 0;
}
```
